/*
  Module 07 - Automotive Ethernet
  MG Hector IVI Validation
  Purpose: Simulate Ethernet gateway status messages on CAN that indicate
           SOME/IP service availability, TCP/IP stack state, and Ethernet PHY link
  Signals: BCM_PowerMode, VCU_VehicleSpeed, GW_Eth_Status (0x3A0)
*/

variables
{
  msTimer tPowerMode;
  msTimer tVehicleSpeed;
  msTimer tEthStatus;
  int gPowerMode = 0;
  long gSpeedRaw = 0;
  int gAlive = 0;
  int gEthLinkUp = 0;
  int gSomeIpServiceReady = 0;
}

on start
{
  write("[07_AUTOMOTIVE_ETHERNET] Ethernet gateway status simulation via CAN");
  write("Keys: i=IGN e=Eth UP f=Eth DOWN s=SOME/IP service x=PHY fault h=status");
  setTimer(tPowerMode, 10);
  setTimer(tVehicleSpeed, 20);
  setTimer(tHeartbeatCheck, 100);
}

on timer tPowerMode
{
  message BCM_PowerMode msg;
  msg.PowerMode = gPowerMode;
  msg.AliveCounter = gAlive & 0x0F;
  output(msg);
  setTimer(tPowerMode, 10);
}

on timer tVehicleSpeed
{
  message VCU_VehicleSpeed spd;
  spd.VehicleSpeed_kph = gSpeedRaw;
  output(spd);
  setTimer(tVehicleSpeed, 20);
}

on timer tHeartbeatCheck
{
  gAlive++;
  if (gAlive > 15) gAlive = 0;
  setTimer(tHeartbeatCheck, 100);
}

void setIgnitionOn()
{
  gPowerMode = 2;
  write("PowerMode -> IGN");
}

void setAccessory()
{
  gPowerMode = 1;
  write("PowerMode -> ACC");
}

void setIgnitionOff()
{
  gPowerMode = 0;
  gSpeedRaw = 0;
  write("PowerMode -> OFF");
}

void setReverseGear()
{
  message TCU_GearStatus gear;
  gGear = 1;
  gear.GearPosition = gGear;
  output(gear);
  write("Gear -> Reverse");
}

void setVehicleSpeed(float speedKph)
{
  gSpeedRaw = (long)(speedKph * 100.0);
  write("VehicleSpeed -> %.2f kph", speedKph);
}

on key 'i' { setIgnitionOn(); }
on key 'a' { setAccessory(); }
on key 'o' { setIgnitionOff(); }
on key 'r' { setReverseGear(); }
on key '5' { setVehicleSpeed(5.0); }

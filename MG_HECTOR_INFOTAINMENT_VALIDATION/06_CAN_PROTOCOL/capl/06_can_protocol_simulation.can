/*
  Module 06 - CAN Protocol
  MG Hector IVI Validation
  Purpose: Demonstrate CAN frame structure, error handling, bus load monitoring,
           and frame injection including DLC variation and error frame generation
  Signals: BCM_PowerMode, VCU_VehicleSpeed, plus bus load test frames
*/

variables
{
  msTimer tPowerMode;
  msTimer tVehicleSpeed;
  msTimer tBusLoad;
  int gPowerMode = 0;
  long gSpeedRaw = 0;
  int gAlive = 0;
  int gBusLoadActive = 0;
  int gFrameCounter = 0;
  int gErrorCount = 0;
}

on start
{
  write("[06_CAN_PROTOCOL] CAN frame injection and bus load testing");
  write("Keys: i=IGN l=high load e=error inject f=flood test b=busoff reset h=status");
  setTimer(tPowerMode, 10);
  setTimer(tVehicleSpeed, 20);
  setTimer(tHeartbeatCheck, 100);
}

on timer tPowerMode
{
  message BCM_PowerMode msg;
  msg.PowerMode = gPowerMode;
  msg.AliveCounter = gAlive & 0x0F;
  output(msg);
  setTimer(tPowerMode, 10);
}

on timer tVehicleSpeed
{
  message VCU_VehicleSpeed spd;
  spd.VehicleSpeed_kph = gSpeedRaw;
  output(spd);
  setTimer(tVehicleSpeed, 20);
}

on timer tHeartbeatCheck
{
  gAlive++;
  if (gAlive > 15) gAlive = 0;
  setTimer(tHeartbeatCheck, 100);
}

void setIgnitionOn()
{
  gPowerMode = 2;
  write("PowerMode -> IGN");
}

void setAccessory()
{
  gPowerMode = 1;
  write("PowerMode -> ACC");
}

void setIgnitionOff()
{
  gPowerMode = 0;
  gSpeedRaw = 0;
  write("PowerMode -> OFF");
}

void setReverseGear()
{
  message TCU_GearStatus gear;
  gGear = 1;
  gear.GearPosition = gGear;
  output(gear);
  write("Gear -> Reverse");
}

void setVehicleSpeed(float speedKph)
{
  gSpeedRaw = (long)(speedKph * 100.0);
  write("VehicleSpeed -> %.2f kph", speedKph);
}

on key 'i' { setIgnitionOn(); }
on key 'a' { setAccessory(); }
on key 'o' { setIgnitionOff(); }
on key 'r' { setReverseGear(); }
on key '5' { setVehicleSpeed(5.0); }

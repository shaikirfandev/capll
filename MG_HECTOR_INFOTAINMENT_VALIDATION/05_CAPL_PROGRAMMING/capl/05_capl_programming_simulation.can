/*
  Module 05 - CAPL Programming
  MG Hector IVI Validation
  Purpose: Demonstrate core CAPL language patterns including timers, messages,
           signal access, environment variables, system variables, and verdicts
  Signals: BCM_PowerMode, VCU_VehicleSpeed, TCU_GearStatus, SWC_Buttons,
           BCM_DoorStatus, IVI_Heartbeat, IVI_Status
*/

variables
{
  msTimer tPowerMode;
  msTimer tVehicleSpeed;
  msTimer tIviPublish;
  msTimer tTestTimer;
  int gPowerMode = 0;
  int gGear = 0;
  long gSpeedRaw = 0;
  int gAlive = 0;
  int gIviBoot = 0;
  int gTestPass = 0;
  int gTestFail = 0;
}

on start
{
  write("[05_CAPL_PROGRAMMING] CAPL pattern demonstrations - timers/messages/envvars");
  write("Keys: i=IGN a=ACC o=OFF e=env test g=getValue t=timer test v=verdict h=status");
  setTimer(tPowerMode, 10);
  setTimer(tVehicleSpeed, 20);
  setTimer(tHeartbeatCheck, 100);
}

on timer tPowerMode
{
  message BCM_PowerMode msg;
  msg.PowerMode = gPowerMode;
  msg.AliveCounter = gAlive & 0x0F;
  output(msg);
  setTimer(tPowerMode, 10);
}

on timer tVehicleSpeed
{
  message VCU_VehicleSpeed spd;
  spd.VehicleSpeed_kph = gSpeedRaw;
  output(spd);
  setTimer(tVehicleSpeed, 20);
}

on timer tHeartbeatCheck
{
  gAlive++;
  if (gAlive > 15) gAlive = 0;
  setTimer(tHeartbeatCheck, 100);
}

void setIgnitionOn()
{
  gPowerMode = 2;
  write("PowerMode -> IGN");
}

void setAccessory()
{
  gPowerMode = 1;
  write("PowerMode -> ACC");
}

void setIgnitionOff()
{
  gPowerMode = 0;
  gSpeedRaw = 0;
  write("PowerMode -> OFF");
}

void setReverseGear()
{
  message TCU_GearStatus gear;
  gGear = 1;
  gear.GearPosition = gGear;
  output(gear);
  write("Gear -> Reverse");
}

void setVehicleSpeed(float speedKph)
{
  gSpeedRaw = (long)(speedKph * 100.0);
  write("VehicleSpeed -> %.2f kph", speedKph);
}

on key 'i' { setIgnitionOn(); }
on key 'a' { setAccessory(); }
on key 'o' { setIgnitionOff(); }
on key 'r' { setReverseGear(); }
on key '5' { setVehicleSpeed(5.0); }

/*
  Module 30 - Automation Framework
  MG Hector IVI Validation
  Purpose: Automated test sequence runner with verdict logging, parametric
           test execution, and pass/fail criteria evaluation
  Signals: BCM_PowerMode, IVI_Heartbeat, IVI_Status, plus test coordination
*/

variables
{
  msTimer tPowerMode;
  msTimer tIviPublish;
  msTimer tAutoTest;
  int gPowerMode = 0;
  int gAlive = 0;
  int gIviBoot = 0;
  int gTestRunning = 0;
  int gTestPass = 0;
  int gTestFail = 0;
  int gTestStep = 0;
}

on start
{
  write("[30_AUTOMATION_FRAMEWORK] Automated test sequence with verdicts");
  write("Keys: i=IGN t=Run test suite s=Step next x=Stop test r=Report s=status");
  setTimer(tPowerMode, 10);
  setTimer(tVehicleSpeed, 20);
  setTimer(tHeartbeatCheck, 100);
}

on timer tPowerMode
{
  message BCM_PowerMode msg;
  msg.PowerMode = gPowerMode;
  msg.AliveCounter = gAlive & 0x0F;
  output(msg);
  setTimer(tPowerMode, 10);
}

on timer tVehicleSpeed
{
  message VCU_VehicleSpeed spd;
  spd.VehicleSpeed_kph = gSpeedRaw;
  output(spd);
  setTimer(tVehicleSpeed, 20);
}

on timer tHeartbeatCheck
{
  gAlive++;
  if (gAlive > 15) gAlive = 0;
  setTimer(tHeartbeatCheck, 100);
}

void setIgnitionOn()
{
  gPowerMode = 2;
  write("PowerMode -> IGN");
}

void setAccessory()
{
  gPowerMode = 1;
  write("PowerMode -> ACC");
}

void setIgnitionOff()
{
  gPowerMode = 0;
  gSpeedRaw = 0;
  write("PowerMode -> OFF");
}

void setReverseGear()
{
  message TCU_GearStatus gear;
  gGear = 1;
  gear.GearPosition = gGear;
  output(gear);
  write("Gear -> Reverse");
}

void setVehicleSpeed(float speedKph)
{
  gSpeedRaw = (long)(speedKph * 100.0);
  write("VehicleSpeed -> %.2f kph", speedKph);
}

on key 'i' { setIgnitionOn(); }
on key 'a' { setAccessory(); }
on key 'o' { setIgnitionOff(); }
on key 'r' { setReverseGear(); }
on key '5' { setVehicleSpeed(5.0); }

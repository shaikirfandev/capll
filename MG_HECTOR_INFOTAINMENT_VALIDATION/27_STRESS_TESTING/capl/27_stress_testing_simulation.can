/*
  Module 27 - Stress Testing
  MG Hector IVI Validation
  Purpose: Continuous rapid message injection, fault injection, power cycling,
           and long-duration stress patterns to find IVI robustness issues
  Signals: BCM_PowerMode, VCU_VehicleSpeed, plus stress test frames
*/

variables
{
  msTimer tPowerMode;
  msTimer tVehicleSpeed;
  msTimer tStressTimer;
  int gPowerMode = 0;
  long gSpeedRaw = 0;
  int gAlive = 0;
  int gStressActive = 0;
  int gCycleCount = 0;
  int gFaultInjected = 0;
}

on start
{
  write("[27_STRESS_TESTING] Continuous stress and fault injection");
  write("Keys: i=IGN s=Stress start x=Stress stop f=Fault inject p=Power cycle h=status");
  setTimer(tPowerMode, 10);
  setTimer(tVehicleSpeed, 20);
  setTimer(tHeartbeatCheck, 100);
}

on timer tPowerMode
{
  message BCM_PowerMode msg;
  msg.PowerMode = gPowerMode;
  msg.AliveCounter = gAlive & 0x0F;
  output(msg);
  setTimer(tPowerMode, 10);
}

on timer tVehicleSpeed
{
  message VCU_VehicleSpeed spd;
  spd.VehicleSpeed_kph = gSpeedRaw;
  output(spd);
  setTimer(tVehicleSpeed, 20);
}

on timer tHeartbeatCheck
{
  gAlive++;
  if (gAlive > 15) gAlive = 0;
  setTimer(tHeartbeatCheck, 100);
}

void setIgnitionOn()
{
  gPowerMode = 2;
  write("PowerMode -> IGN");
}

void setAccessory()
{
  gPowerMode = 1;
  write("PowerMode -> ACC");
}

void setIgnitionOff()
{
  gPowerMode = 0;
  gSpeedRaw = 0;
  write("PowerMode -> OFF");
}

void setReverseGear()
{
  message TCU_GearStatus gear;
  gGear = 1;
  gear.GearPosition = gGear;
  output(gear);
  write("Gear -> Reverse");
}

void setVehicleSpeed(float speedKph)
{
  gSpeedRaw = (long)(speedKph * 100.0);
  write("VehicleSpeed -> %.2f kph", speedKph);
}

on key 'i' { setIgnitionOn(); }
on key 'a' { setAccessory(); }
on key 'o' { setIgnitionOff(); }
on key 'r' { setReverseGear(); }
on key '5' { setVehicleSpeed(5.0); }

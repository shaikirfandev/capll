/*
  Module 13 - CarPlay Android Auto
  MG Hector IVI Validation
  Purpose: Simulate CarPlay and Android Auto session state, connection,
           disconnection, and audio routing changes on CAN
  Signals: BCM_PowerMode, IVI_Status, USB_DeviceState, CarPlay_SessionState (0x370),
           AndroidAuto_SessionState (0x371)
*/

variables
{
  msTimer tPowerMode;
  msTimer tIviPublish;
  msTimer tCarPlayPublish;
  int gPowerMode = 0;
  int gAlive = 0;
  int gIviBoot = 0;
  int gCarPlayActive = 0;
  int gAndroidAutoActive = 0;
}

on start
{
  write("[13_CARPLAY_ANDROID_AUTO] CarPlay/AA session state simulation");
  write("Keys: i=IGN c=CarPlay start x=CarPlay stop a=AA start z=AA stop s=status");
  setTimer(tPowerMode, 10);
  setTimer(tVehicleSpeed, 20);
  setTimer(tHeartbeatCheck, 100);
}

on timer tPowerMode
{
  message BCM_PowerMode msg;
  msg.PowerMode = gPowerMode;
  msg.AliveCounter = gAlive & 0x0F;
  output(msg);
  setTimer(tPowerMode, 10);
}

on timer tVehicleSpeed
{
  message VCU_VehicleSpeed spd;
  spd.VehicleSpeed_kph = gSpeedRaw;
  output(spd);
  setTimer(tVehicleSpeed, 20);
}

on timer tHeartbeatCheck
{
  gAlive++;
  if (gAlive > 15) gAlive = 0;
  setTimer(tHeartbeatCheck, 100);
}

void setIgnitionOn()
{
  gPowerMode = 2;
  write("PowerMode -> IGN");
}

void setAccessory()
{
  gPowerMode = 1;
  write("PowerMode -> ACC");
}

void setIgnitionOff()
{
  gPowerMode = 0;
  gSpeedRaw = 0;
  write("PowerMode -> OFF");
}

void setReverseGear()
{
  message TCU_GearStatus gear;
  gGear = 1;
  gear.GearPosition = gGear;
  output(gear);
  write("Gear -> Reverse");
}

void setVehicleSpeed(float speedKph)
{
  gSpeedRaw = (long)(speedKph * 100.0);
  write("VehicleSpeed -> %.2f kph", speedKph);
}

on key 'i' { setIgnitionOn(); }
on key 'a' { setAccessory(); }
on key 'o' { setIgnitionOff(); }
on key 'r' { setReverseGear(); }
on key '5' { setVehicleSpeed(5.0); }

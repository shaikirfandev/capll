/*
  Module 01 - Automotive Basics
  MG Hector IVI Validation Bench
  Purpose : Demonstrate core body and IVI signals used across the training bench.
  DBC     : MG_Hector_IVI_Training.dbc
  Signals : BCM_PowerMode, BCM_DoorStatus, VCU_VehicleSpeed,
            TCU_GearStatus, IVI_Heartbeat, IVI_Status
*/

variables
{
  msTimer tPowerMode;
  msTimer tVehicleSpeed;
  msTimer tIviPublish;
  int gPowerMode = 0;
  int gGear = 0;
  int gDriverDoor = 0;
  long gSpeedRaw = 0;
  int gAlive = 0;
  int gBootState = 0;
  int gCycleCount = 0;
}

on start
{
  write("[01_AUTOMOTIVE_BASICS] Core signal simulation started");
  write("Keys: i=IGN a=ACC o=OFF c=CRANK d=Drive r=Reverse p=Park 1/2/3=speed m=door h=status");
  setTimer(tPowerMode, 10);
  setTimer(tVehicleSpeed, 20);
  setTimer(tIviPublish, 100);
}

on timer tPowerMode
{
  message BCM_PowerMode msg;
  msg.PowerMode = gPowerMode;
  msg.AliveCounter = gAlive & 0x0F;
  output(msg);
  gAlive++;
  if (gAlive > 15) gAlive = 0;
  gCycleCount++;
  setTimer(tPowerMode, 10);
}

on timer tVehicleSpeed
{
  message VCU_VehicleSpeed spd;
  spd.VehicleSpeed_kph = gSpeedRaw;
  output(spd);
  setTimer(tVehicleSpeed, 20);
}

on timer tIviPublish
{
  message IVI_Heartbeat hb;
  message IVI_Status status;
  hb.IVI_AliveCounter = gAlive & 0x0F;
  status.IVI_BootState = gBootState;
  output(hb);
  output(status);
  setTimer(tIviPublish, 100);
}

void setPowerMode(int mode, char name[])
{
  gPowerMode = mode;
  if (mode == 0)
  {
    gSpeedRaw = 0;
    gBootState = 0;
  }
  else if (mode == 1)
  {
    gBootState = 1;
  }
  else
  {
    gBootState = 2;
  }
  write("[BCM] PowerMode -> %s (%d)", name, mode);
}

void setGear(int gearPos, char name[])
{
  message TCU_GearStatus gear;
  gGear = gearPos;
  gear.GearPosition = gGear;
  output(gear);
  write("[TCU] Gear -> %s", name);
}

void setSpeed(float kph)
{
  gSpeedRaw = (long)(kph * 100.0);
  write("[VCU] VehicleSpeed -> %.1f kph", kph);
}

void setDoorState(int isOpen)
{
  message BCM_DoorStatus door;
  gDriverDoor = isOpen;
  door.DriverDoorAjar = gDriverDoor;
  output(door);
  write("[BCM] DriverDoor -> %s", isOpen ? "OPEN" : "CLOSED");
}

on key 'i' { setPowerMode(2, "IGN"); }
on key 'a' { setPowerMode(1, "ACC"); }
on key 'o' { setPowerMode(0, "OFF"); }
on key 'c' { setPowerMode(3, "CRANK"); setPowerMode(2, "IGN"); }
on key 'r' { setGear(1, "Reverse"); }
on key 'd' { setGear(3, "Drive"); }
on key 'p' { setGear(0, "Park"); }
on key '1' { setSpeed(0.0); }
on key '2' { setSpeed(15.0); }
on key '3' { setSpeed(60.0); }
on key 'm' { setDoorState(!gDriverDoor); }
on key 's'
{
  write("[STATUS] Cycles=%d Power=%d Gear=%d Door=%d Speed=%.1f Boot=%d",
        gCycleCount, gPowerMode, gGear, gDriverDoor, gSpeedRaw / 100.0, gBootState);
}

/*
  Module 09 - IVI Features
  MG Hector IVI Validation
  Purpose: Demonstrate feature enable/disable flags and mode switching for
           MG Hector IVI including Bluetooth, WiFi, navigation, audio sources
  Signals: BCM_PowerMode, IVI_Heartbeat, IVI_Status, IVI_FeatureFlags (0x305)
*/

variables
{
  msTimer tPowerMode;
  msTimer tIviPublish;
  msTimer tFeaturePublish;
  int gPowerMode = 0;
  int gAlive = 0;
  int gIviBoot = 0;
  int gBtEnabled = 0;
  int gWifiEnabled = 0;
  int gNavEnabled = 0;
  int gAudioMode = 0;
}

on start
{
  write("[09_IVI_FEATURES] IVI feature flag and mode simulation");
  write("Keys: i=IGN b=BT enable w=WiFi enable n=Nav enable a=Audio mode h=status");
  setTimer(tPowerMode, 10);
  setTimer(tVehicleSpeed, 20);
  setTimer(tHeartbeatCheck, 100);
}

on timer tPowerMode
{
  message BCM_PowerMode msg;
  msg.PowerMode = gPowerMode;
  msg.AliveCounter = gAlive & 0x0F;
  output(msg);
  setTimer(tPowerMode, 10);
}

on timer tVehicleSpeed
{
  message VCU_VehicleSpeed spd;
  spd.VehicleSpeed_kph = gSpeedRaw;
  output(spd);
  setTimer(tVehicleSpeed, 20);
}

on timer tHeartbeatCheck
{
  gAlive++;
  if (gAlive > 15) gAlive = 0;
  setTimer(tHeartbeatCheck, 100);
}

void setIgnitionOn()
{
  gPowerMode = 2;
  write("PowerMode -> IGN");
}

void setAccessory()
{
  gPowerMode = 1;
  write("PowerMode -> ACC");
}

void setIgnitionOff()
{
  gPowerMode = 0;
  gSpeedRaw = 0;
  write("PowerMode -> OFF");
}

void setReverseGear()
{
  message TCU_GearStatus gear;
  gGear = 1;
  gear.GearPosition = gGear;
  output(gear);
  write("Gear -> Reverse");
}

void setVehicleSpeed(float speedKph)
{
  gSpeedRaw = (long)(speedKph * 100.0);
  write("VehicleSpeed -> %.2f kph", speedKph);
}

on key 'i' { setIgnitionOn(); }
on key 'a' { setAccessory(); }
on key 'o' { setIgnitionOff(); }
on key 'r' { setReverseGear(); }
on key '5' { setVehicleSpeed(5.0); }

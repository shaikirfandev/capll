/*
 * can_security_monitor.can
 * CAN Security Monitor — Automotive Cybersecurity Lab
 *
 * CAPL IDS (Intrusion Detection System) for CANoe test environment:
 *   - Message ID whitelist enforcement
 *   - DLC validation per message ID
 *   - Message cycle time monitoring (flood/injection detection)
 *   - SecOC-style freshness counter validation (8-bit counter in byte 0)
 *   - Bus load monitoring with configurable threshold
 *   - Security event logging with timestamps
 *
 * Usage: Attach to CANoe network node, configure whitelist and expected DLCs.
 * All alerts are written to Write window and test report.
 *
 * Compatible: CANoe 10.0+
 */

includes
{
}

variables
{
  /* ─── Configuration ─────────────────────────────────────────────────── */
  const int    MONITOR_CHANNEL    = 1;
  const double BUS_LOAD_THRESHOLD = 70.0;    /* Alert if bus load > 70% */
  const double CYCLE_TOLERANCE    = 0.5;     /* 50% deviation = anomaly */
  const int    LEARN_FRAMES       = 20;      /* Frames to learn cycle time */
  const int    SECOC_COUNTER_BITS = 8;       /* 8-bit freshness counter */

  /* ─── Whitelist: known CAN IDs ─────────────────────────────────────── */
  /* Format: {arbitration_id, expected_DLC} */
  /* Add all known ECU message IDs here */
  int   whitelist_ids[16]  = {0x100, 0x200, 0x244, 0x300, 0x320, 0x400,
                               0x420, 0x500, 0x510, 0x600, 0x640, 0x700,
                               0x7DF, 0x7E0, 0x7E8, 0xFFFF};  /* 0xFFFF = unused */
  int   whitelist_dlc[16]  = {8,     8,     8,     8,     4,    8,
                               6,     8,     8,     8,     2,    8,
                               8,     8,     8,     0};

  /* ─── Per-ID statistics ─────────────────────────────────────────────── */
  /* Using arrays indexed by ID (16 tracked IDs max) */
  long  stat_count[16];
  double stat_last_time[16];
  double stat_sum_gap[16];
  int   stat_learn_done[16];
  double stat_expected_gap[16];

  /* ─── SecOC counters ────────────────────────────────────────────────── */
  /* Track freshness counter per secured message ID */
  /* Secured IDs: 0x244 (idx=2), 0x300 (idx=3) */
  int   secoc_last_counter[4];       /* -1 = not yet initialized */
  int   secoc_secured_ids[4]   = {0x244, 0x300, 0xFFFF, 0xFFFF};

  /* ─── Bus load tracking ─────────────────────────────────────────────── */
  int   frame_count_window;
  msTimer busLoadTimer;
  double  bus_load_pct;

  /* ─── Alert counters ────────────────────────────────────────────────── */
  int total_unknown_id_alerts;
  int total_dlc_alerts;
  int total_cycle_alerts;
  int total_secoc_alerts;
  int total_busload_alerts;
}

/* ─── INITIALIZATION ──────────────────────────────────────────────────────── */

on start
{
  int i;

  /* Initialize stats */
  for (i = 0; i < 16; i++) {
    stat_count[i]        = 0;
    stat_last_time[i]    = 0.0;
    stat_sum_gap[i]      = 0.0;
    stat_learn_done[i]   = 0;
    stat_expected_gap[i] = 0.0;
  }

  for (i = 0; i < 4; i++) {
    secoc_last_counter[i] = -1;
  }

  frame_count_window    = 0;
  total_unknown_id_alerts = 0;
  total_dlc_alerts      = 0;
  total_cycle_alerts    = 0;
  total_secoc_alerts    = 0;
  total_busload_alerts  = 0;

  /* Start bus load measurement window (1 second) */
  setTimer(busLoadTimer, 1000);

  write("=== CAN Security Monitor STARTED ===");
  write("Whitelist: 16 IDs | Bus load threshold: %.0f%%", BUS_LOAD_THRESHOLD);
  write("Cycle time tolerance: %.0f%% | SecOC counter bits: %d",
        CYCLE_TOLERANCE * 100, SECOC_COUNTER_BITS);
  write("─────────────────────────────────────────────────────────");
}

/* ─── MESSAGE HANDLER (all CAN messages) ─────────────────────────────────── */

on message *
{
  int    idx;
  int    id_found;
  double now;
  double gap;
  int    i;
  int    cur_ctr;
  int    exp_ctr;
  char   alert_buf[128];

  now = timeNow() / 100000.0;  /* Convert to seconds (timeNow = 100ns units) */
  frame_count_window++;

  id_found = -1;

  /* ─── STEP 1: Whitelist Check ────────────────────────────────────────── */
  for (i = 0; i < 16; i++) {
    if (whitelist_ids[i] == this.id) {
      id_found = i;
      break;
    }
  }

  if (id_found < 0) {
    /* ID not in whitelist */
    total_unknown_id_alerts++;
    snprintf(alert_buf, 128, "[SECURITY] UNKNOWN_ID: 0x%03X DLC=%d Time=%.3fs",
             this.id, this.dlc, now);
    write("%s", alert_buf);
    /* Only report unknown IDs once per ID to avoid noise */
    /* (Use a seen-set in real implementation with larger arrays) */
    return;
  }

  idx = id_found;
  stat_count[idx]++;

  /* ─── STEP 2: DLC Validation ─────────────────────────────────────────── */
  if (this.dlc != whitelist_dlc[idx]) {
    total_dlc_alerts++;
    snprintf(alert_buf, 128, "[SECURITY] DLC_ANOMALY: ID=0x%03X DLC=%d expected=%d",
             this.id, this.dlc, whitelist_dlc[idx]);
    write("%s", alert_buf);
  }

  /* ─── STEP 3: Cycle Time Monitoring ──────────────────────────────────── */
  if (stat_last_time[idx] > 0.0) {
    gap = now - stat_last_time[idx];

    if (stat_count[idx] <= LEARN_FRAMES) {
      /* Learning phase */
      stat_sum_gap[idx] += gap;
      if (stat_count[idx] == LEARN_FRAMES) {
        stat_expected_gap[idx] = stat_sum_gap[idx] / (LEARN_FRAMES - 1);
        stat_learn_done[idx]   = 1;
        write("[MONITOR] Learned cycle time for 0x%03X: %.1fms",
              this.id, stat_expected_gap[idx] * 1000);
      }
    } else if (stat_learn_done[idx]) {
      /* Check against learned baseline */
      double expected = stat_expected_gap[idx];
      if (expected > 0.0 && gap < expected * CYCLE_TOLERANCE) {
        total_cycle_alerts++;
        snprintf(alert_buf, 128,
                 "[SECURITY] CYCLE_ANOMALY: ID=0x%03X gap=%.1fms expected=%.1fms (%.0f%% early)",
                 this.id, gap * 1000, expected * 1000,
                 (1.0 - gap / expected) * 100);
        write("%s", alert_buf);
      }
    }
  }
  stat_last_time[idx] = now;

  /* ─── STEP 4: SecOC Freshness Counter Check ───────────────────────────── */
  for (i = 0; i < 4; i++) {
    if (secoc_secured_ids[i] == this.id && this.dlc >= 1) {
      cur_ctr = this.byte(0);  /* Freshness counter in byte 0 */

      if (secoc_last_counter[i] >= 0) {
        /* Expected: counter increments by 1 (with rollover at 0xFF) */
        exp_ctr = (secoc_last_counter[i] + 1) & 0xFF;

        if (cur_ctr == secoc_last_counter[i]) {
          /* Exact replay: same counter value */
          total_secoc_alerts++;
          snprintf(alert_buf, 128,
                   "[SECURITY] SECOC_REPLAY: ID=0x%03X counter=0x%02X (unchanged) POSSIBLE REPLAY ATTACK",
                   this.id, cur_ctr);
          write("%s", alert_buf);
        } else if (cur_ctr != exp_ctr) {
          /* Counter jumped or went backwards */
          int delta;
          delta = cur_ctr - secoc_last_counter[i];
          if (delta < 0) delta = -delta;

          if (delta > 10) {
            /* Large jump — suspicious */
            total_secoc_alerts++;
            snprintf(alert_buf, 128,
                     "[SECURITY] SECOC_COUNTER_JUMP: ID=0x%03X counter=0x%02X expected=0x%02X delta=%d",
                     this.id, cur_ctr, exp_ctr, delta);
            write("%s", alert_buf);
          } else {
            /* Small skip — may be missed frames, log at lower severity */
            write("[MONITOR] SecOC counter skip: ID=0x%03X counter=0x%02X expected=0x%02X",
                  this.id, cur_ctr, exp_ctr);
          }
        }
      }
      secoc_last_counter[i] = cur_ctr;
      break;
    }
  }
}

/* ─── BUS LOAD TIMER (1-second window) ───────────────────────────────────── */

on timer busLoadTimer
{
  /*
   * CAN 500Kbps with 8-byte frames:
   * Frame = 1 (SOF) + 11 (ID) + 1 (RTR) + 1 (IDE) + 1 (r0) + 4 (DLC)
   *       + 64 (data) + 15 (CRC) + 1 (CRC delim) + 1 (ACK) + 1 (ACK delim)
   *       + 7 (EOF) + 3 (IFS) = ~110 bits per standard data frame
   * Max frames/sec @ 500Kbps = 500000 / 110 ≈ 4545 frames/sec
   */
  const double MAX_FRAMES_PER_SEC = 4545.0;

  bus_load_pct = (frame_count_window / MAX_FRAMES_PER_SEC) * 100.0;

  if (bus_load_pct > BUS_LOAD_THRESHOLD) {
    total_busload_alerts++;
    write("[SECURITY] HIGH_BUS_LOAD: %.1f%% (%d frames/sec) — possible DoS attack",
          bus_load_pct, frame_count_window);
  } else {
    write("[MONITOR] Bus load: %.1f%% (%d frames/sec)", bus_load_pct, frame_count_window);
  }

  frame_count_window = 0;
  setTimer(busLoadTimer, 1000);
}

/* ─── STOP HANDLER ────────────────────────────────────────────────────────── */

on stopMeasurement
{
  write("─────────────────────────────────────────────────────────");
  write("=== CAN Security Monitor SUMMARY ===");
  write("Unknown ID alerts:     %d", total_unknown_id_alerts);
  write("DLC anomaly alerts:    %d", total_dlc_alerts);
  write("Cycle time alerts:     %d", total_cycle_alerts);
  write("SecOC replay alerts:   %d", total_secoc_alerts);
  write("Bus load alerts:       %d", total_busload_alerts);
  write("Total security events: %d",
        total_unknown_id_alerts + total_dlc_alerts + total_cycle_alerts +
        total_secoc_alerts + total_busload_alerts);
  write("=================================================");
}
